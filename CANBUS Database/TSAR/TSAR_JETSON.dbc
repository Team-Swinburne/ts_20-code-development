VERSION ""

NS_ :

BS_:

BU_:

BO_ 1280 ECU: 6 Vector__XXX
 SG_ HeatBeat_Counter : 7|8@0+ (1,0) [0|0] "" Vector__XXX
 SG_ Steering_CMD : 15|16@0- (0.1,0) [-900|900] "°" Vector__XXX
 SG_ Throttle_CMD : 31|8@0+ (1,0) [0|100] "%" Vector__XXX
 SG_ Speed_Value : 39|8@0+ (1,0) [0|0] "km/h" Vector__XXX
 SG_ Brake_CMD : 47|8@0+ (1,0) [0|0] "%" Vector__XXX
 SG_ AS_State : 7|8@0+ (1,0) [0|0] "" Vector__XXX
