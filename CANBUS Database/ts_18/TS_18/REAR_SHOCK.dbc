VERSION ""

NS_ :

BS_:

BU_:

BO_ 362 REARSHOCK: 8 Vector__XXX
 SG_ analog1 : 0|10@1+ (10,0) [0|0] "" Vector__XXX
 SG_ analog2 : 16|10@1+ (10,0) [0|0] "" Vector__XXX
