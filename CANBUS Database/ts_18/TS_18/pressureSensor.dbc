VERSION ""

NS_ :

BS_:

BU_:

BO_ 160 Pressure: 8 Vector__XXX
 SG_ pressure_01 : 0|16@1+ (10,0) [0|0] "kPa" Vector__XXX

BA_DEF_  "BusType" STRING ;
BA_DEF_DEF_  "BusType" "CAN";
