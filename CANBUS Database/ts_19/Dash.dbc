VERSION ""

NS_ :

BS_:

BU_:

BO_ 800 DASH_HEARTBEAT_ID: 8 Vector__XXX
 SG_ dash_heartbeat_counter : 8|8@1+ (1,0) [0|0] "" Vector__XXX
 SG_ dash_heartbeat_state : 0|8@1+ (1,0) [0|0] "" Vector__XXX
