VERSION ""

NS_ :

BS_:

BU_:

BO_ 880 HEARTBEAT: 8 Vector__XXX
 SG_ State : 0|8@1+ (1,0) [0|0] "" Vector__XXX
 SG_ Counter : 8|8@1+ (1,0) [0|0] "" Vector__XXX

BO_ 881 ERROR: 8 Vector__XXX
 SG_ Low_FlowRate : 0|8@1+ (1,0) [0|0] "" Vector__XXX

BO_ 884 ANALOGUE: 8 Vector__XXX
 SG_ FR_FlowRate : 0|8@1+ (1,0) [0|0] "" Vector__XXX
 SG_ FR_BellCrank : 8|8@1+ (1,0) [0|0] "" Vector__XXX
