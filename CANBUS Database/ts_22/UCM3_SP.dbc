VERSION ""

NS_ :

BS_:

BU_:

BO_ 3221225472 VECTOR__INDEPENDENT_SIG_MSG: 0 Vector__XXX
 SG_ Low_FlowRate : 0|8@1+ (1,0) [0|0] "" Vector__XXX

BO_ 896 HEARTBEAT: 8 Vector__XXX
 SG_ State : 0|8@1+ (1,0) [0|0] "" Vector__XXX
 SG_ Counter : 8|8@1+ (1,0) [0|0] "" Vector__XXX

BO_ 897 ERROR: 8 Vector__XXX

BO_ 900 ANALOGUE: 8 Vector__XXX
 SG_ Left_RadTemp : 0|8@1+ (1,0) [0|0] "" Vector__XXX
 SG_ Right_RadTemp : 8|8@1+ (1,0) [0|0] "" Vector__XXX
